float temp_P(float x)
{
  return -3/10 + x/75;
}

float P_list[256] = 
{
 8.42752E-06,
9.23963E-06,
1.013E-05,
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0.999991572,
0.999992313
};

int pos_from_P(float x)
{
  int start=0, end=63,i;
  for(i=1;i<8;i++)
  {
    if(x> P_list[(start+end)/2])
    start = (start+end)/2;

    if(x< P_list[(start+end)/2])
    end = (start+end)/2;

    if(P_list[(start+end)/2]==x)
      return  (start+end)/2;
  }

  return (start+end)/2;
}






void setup() {
  // put your setup code here, to run once:
  sensors.Begin();
  pinMode(2,OUTPUT);
  pinMode(5,OUTPUT);
  pinMode(3,INPUT);
  Serial.begin(9600);




}

const int xstepPin = 2; //X.STEP
const int xdirPin = 5; // X.DIR high up
int nowpos=0;
int i, stepperlen;

void loop() {
  
  float temp , P = temp_P(temp) ;

  
  int pos=pos_from_P(P);
  if(nowpos > pos)
  {
    digitalWrite(xdirPin,LOW);
    for(i=1; i<= (nowpos-pos)*stepperlen;i++)
    {
      digitalWrite(xstepPin,HIGH);
        delayMicroseconds(300);
        digitalWrite(xstepPin,LOW);
        delayMicroseconds(300);
    }
  }

    if(nowpos < pos)
  {
    digitalWrite(xdirPin,HIGH);
    for(i=1; i<= (pos-nowpos)*stepperlen;i++)
    {
      digitalWrite(xstepPin,HIGH);
        delayMicroseconds(300);
        digitalWrite(xstepPin,LOW);
        delayMicroseconds(300);
    }
  }

  nowpos=pos;


}
